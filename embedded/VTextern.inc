;=============================================================
;FILE:      VTextern.inc
; PROJECT:   Tour1.hpr
; Project Created 31/12/2009 14:45:43 by HIDmaker
; Copyright (c) 2005 by Trace Systems, Inc.  

;This file generated 15/01/2010 17:45:38

; Product Name/Project Description: Dip Coater
; Mfr. Name: Construmaq

; Generated by HIDmaker FS ver. 1.5.0.1 [Copyright (c) 2005 by Trace Systems, Inc.]

;=============================================================


#ifdef USB_USE_HID

  extern  EP1_InBuffer
  extern  EP1_OutBuffer

#endif   ; #ifdef USB_USE_HID

  extern  Ep1RcvVarTable, Ep1XmtVarTable, Ep2RcvVarTable, Ep2XmtVarTable
  extern  FeatureVarTable, CtlOutVarTable
