;=============================================================
;FILE:      pdconsts.inc
; PROJECT:   Tour1.hpr
; Project Created 31/12/2009 14:45:43 by HIDmaker
; Copyright (c) 2005 by Trace Systems, Inc.  

;This file generated 15/01/2010 17:45:38

; Product Name/Project Description: Dip Coater
; Mfr. Name: Construmaq

; Generated by HIDmaker FS ver. 1.5.0.1 [Copyright (c) 2005 by Trace Systems, Inc.]

;=============================================================

; ******************************************************************
; Project-dependent constants go here: things like number & size of
; endpoints, number of Configurations and Interfaces, and so on.
; ******************************************************************

#define  MODE_PP     _PPBM0
; Enable ONE of the following two lines, to choose either full speed (default)
; or low speed USB 
#define  UCFG_VAL    _PUEN|_TRINT|_FS|MODE_PP  ; Full-speed
;#define  UCFG_VAL    _PUEN|_TRINT|MODE_PP      ; Low-speed

; Enable one of these if you are dedicating a pin to sense connection to the USB
;#define  USE_SELF_POWER_SENSE_IO
;#define  USE_USB_BUS_SENSE_IO

; Project-specific constants that pertain to the whole device 
#define  EP0_BUFF_SIZE   8	; 8, 16, 32, or 64
#define  MAX_NUM_INT     3	; For Interface Alternates

; CLASS USAGE in this device
; Indicate that HID class is being used (for conditional compile directives)
#define  USB_USE_HID

#define  NUM_CONFIGURATIONS  1

; For Configuration 1: 
; ==================== 
#define  NUM_INTERFACES  1
#define  C1_MAX_EP_NUMBER   1
; Define Endpoint size constants for Configuration 1:

; C1_In_Endpoints:
#define  EP1_IN_BUFF_SIZE    64  ; 8, 16, 32, or 64 if used; 0 if EP is unused
#define  EP2_IN_BUFF_SIZE    0  ; 8, 16, 32, or 64 if used; 0 if EP is unused
#define  EP3_IN_BUFF_SIZE    0  ; 8, 16, 32, or 64 if used; 0 if EP is unused
#define  EP4_IN_BUFF_SIZE    0  ; 8, 16, 32, or 64 if used; 0 if EP is unused
#define  EP5_IN_BUFF_SIZE    0  ; 8, 16, 32, or 64 if used; 0 if EP is unused
#define  EP6_IN_BUFF_SIZE    0  ; 8, 16, 32, or 64 if used; 0 if EP is unused
#define  EP7_IN_BUFF_SIZE    0  ; 8, 16, 32, or 64 if used; 0 if EP is unused
#define  EP8_IN_BUFF_SIZE    0  ; 8, 16, 32, or 64 if used; 0 if EP is unused
#define  EP9_IN_BUFF_SIZE    0  ; 8, 16, 32, or 64 if used; 0 if EP is unused
#define  EP10_IN_BUFF_SIZE    0  ; 8, 16, 32, or 64 if used; 0 if EP is unused
#define  EP11_IN_BUFF_SIZE    0  ; 8, 16, 32, or 64 if used; 0 if EP is unused
#define  EP12_IN_BUFF_SIZE    0  ; 8, 16, 32, or 64 if used; 0 if EP is unused
#define  EP13_IN_BUFF_SIZE    0  ; 8, 16, 32, or 64 if used; 0 if EP is unused
#define  EP14_IN_BUFF_SIZE    0  ; 8, 16, 32, or 64 if used; 0 if EP is unused
#define  EP15_IN_BUFF_SIZE    0  ; 8, 16, 32, or 64 if used; 0 if EP is unused

; C1_OUT_Endpoints:
#define  EP1_OUT_BUFF_SIZE    64  ; 8, 16, 32, or 64 if used; 0 if EP is unused
#define  EP2_OUT_BUFF_SIZE    0  ; 8, 16, 32, or 64 if used; 0 if EP is unused
#define  EP3_OUT_BUFF_SIZE    0  ; 8, 16, 32, or 64 if used; 0 if EP is unused
#define  EP4_OUT_BUFF_SIZE    0  ; 8, 16, 32, or 64 if used; 0 if EP is unused
#define  EP5_OUT_BUFF_SIZE    0  ; 8, 16, 32, or 64 if used; 0 if EP is unused
#define  EP6_OUT_BUFF_SIZE    0  ; 8, 16, 32, or 64 if used; 0 if EP is unused
#define  EP7_OUT_BUFF_SIZE    0  ; 8, 16, 32, or 64 if used; 0 if EP is unused
#define  EP8_OUT_BUFF_SIZE    0  ; 8, 16, 32, or 64 if used; 0 if EP is unused
#define  EP9_OUT_BUFF_SIZE    0  ; 8, 16, 32, or 64 if used; 0 if EP is unused
#define  EP10_OUT_BUFF_SIZE    0  ; 8, 16, 32, or 64 if used; 0 if EP is unused
#define  EP11_OUT_BUFF_SIZE    0  ; 8, 16, 32, or 64 if used; 0 if EP is unused
#define  EP12_OUT_BUFF_SIZE    0  ; 8, 16, 32, or 64 if used; 0 if EP is unused
#define  EP13_OUT_BUFF_SIZE    0  ; 8, 16, 32, or 64 if used; 0 if EP is unused
#define  EP14_OUT_BUFF_SIZE    0  ; 8, 16, 32, or 64 if used; 0 if EP is unused
#define  EP15_OUT_BUFF_SIZE    0  ; 8, 16, 32, or 64 if used; 0 if EP is unused


;This should have the maximum value of C1_MAX_EP_NUMBER or C2_MAX_EP_NUMBER
#define  MAX_EP_NUMBER   1


